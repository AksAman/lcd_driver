## sample.yaml
```yaml
sample:
  name: LCD Driver Sample
tests:
  sample.lcd.driver:
    tags:
      - LCD
      - gpio
    filter: dt_enabled_alias_with_parent_compat("lcd_rs", "gpio-lcd")
    depends_on: gpio
    harness: led
    integration_platforms:
      - frdm_k64f
```
